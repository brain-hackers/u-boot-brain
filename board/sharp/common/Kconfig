## board/sharp/common/Kconfig
```kconfig
config BRAIN_2G
	bool
	default y if TARGET_PWG5300

config BRAIN_3G_4G
	bool
	default y if TARGET_PWSH1 || TARGET_PWSH2 || TARGET_PWSH3 || \
	TARGET_PWSH4 || TARGET_PWSH5 || TARGET_PWSH6 || TARGET_PWSH7
```

## board/sharp/pwg5300/Kconfig
```kconfig
if TARGET_PWG5300

config SYS_BOARD
	default "pwg5300"

config SYS_VENDOR
	default "sharp"

config SYS_SOC
	default "mxs"

config SYS_CONFIG_NAME
	default "pwg5300"

endif
```

## board/sharp/pwh1/Kconfig
```kconfig
if TARGET_PWH1

config SYS_BOARD
	default "pwh1"

config SYS_VENDOR
	default "sharp"

config SYS_CONFIG_NAME
	default "pwh1"

endif
```

## board/sharp/pwsh1/Kconfig
```kconfig
if TARGET_PWSH1

config SYS_BOARD
	default "pwsh1"

config SYS_VENDOR
	default "sharp"

config SYS_SOC
	default "mxs"

config SYS_CONFIG_NAME
	default "pwsh1"

endif
```

## board/sharp/pwsh2/Kconfig
```kconfig
if TARGET_PWSH2

config SYS_BOARD
	default "pwsh2"

config SYS_VENDOR
	default "sharp"

config SYS_SOC
	default "mxs"

config SYS_CONFIG_NAME
	default "pwsh2"

endif

source "board/sharp/common/Kconfig"
```

## board/sharp/pwsh3/Kconfig
```kconfig
if TARGET_PWSH3

config SYS_BOARD
	default "pwsh3"

config SYS_VENDOR
	default "sharp"

config SYS_SOC
	default "mxs"

config SYS_CONFIG_NAME
	default "pwsh3"

endif

source "board/sharp/common/Kconfig"
```

## board/sharp/pwsh4/Kconfig
```kconfig
if TARGET_PWSH4

config SYS_BOARD
	default "pwsh4"

config SYS_VENDOR
	default "sharp"

config SYS_SOC
	default "mxs"

config SYS_CONFIG_NAME
	default "pwsh4"

endif
```

## board/sharp/pwsh5/Kconfig
```kconfig
if TARGET_PWSH5

config SYS_BOARD
	default "pwsh5"

config SYS_VENDOR
	default "sharp"

config SYS_SOC
	default "mxs"

config SYS_CONFIG_NAME
	default "pwsh5"

endif

source "board/sharp/common/Kconfig"
```

## board/sharp/pwsh7/Kconfig
```kconfig
if TARGET_PWSH7

config SYS_BOARD
	default "pwsh7"

config SYS_VENDOR
	default "sharp"

config SYS_SOC
	default "mxs"

config SYS_CONFIG_NAME
	default "pwsh7"

endif

source "board/sharp/common/Kconfig"
```

## configs/pwh1_defconfig
```kconfig
CONFIG_ARM=y
CONFIG_SYS_THUMB_BUILD=y
CONFIG_ARCH_MX7ULP=y
CONFIG_SYS_TEXT_BASE=0x67800000
CONFIG_TARGET_PWH1=y
CONFIG_NR_DRAM_BANKS=1
CONFIG_SYS_EXTRA_OPTIONS="IMX_CONFIG=board/sharp/pwh1/imximage.cfg"
CONFIG_HUSH_PARSER=y
CONFIG_CMD_BOOTZ=y
# CONFIG_CMD_ELF is not set
# CONFIG_CMD_IMI is not set
# CONFIG_CMD_XIMG is not set
# CONFIG_CMD_FLASH is not set
# CONFIG_CMD_LOADB is not set
# CONFIG_CMD_LOADS is not set
CONFIG_CMD_MMC=y
CONFIG_CMD_FAT=y
CONFIG_OF_CONTROL=y
CONFIG_DEFAULT_DEVICE_TREE="imx7ulp-pwh1"
CONFIG_ENV_IS_IN_MMC=y
# CONFIG_NET is not set
CONFIG_DM=y
CONFIG_DM_GPIO=y
CONFIG_IMX_RGPIO2P=y
# CONFIG_MXC_GPIO is not set
CONFIG_DM_MMC=y
# CONFIG_MMC_VERBOSE is not set
CONFIG_FSL_ESDHC=y
CONFIG_PINCTRL=y
CONFIG_PINCTRL_IMX7ULP=y
CONFIG_DM_SERIAL=y
CONFIG_FSL_LPUART=y
# CONFIG_EFI_LOADER is not set
```

## configs/pwsh5_defconfig
```kconfig
CONFIG_ARM=y
CONFIG_ARCH_MX28=y
CONFIG_SYS_TEXT_BASE=0x40200000
CONFIG_SPL_GPIO_SUPPORT=y
CONFIG_SPL_LIBCOMMON_SUPPORT=y
CONFIG_SPL_LIBGENERIC_SUPPORT=y
CONFIG_TARGET_PWSH5=y
CONFIG_SPL_SERIAL_SUPPORT=y
CONFIG_SPL=y
CONFIG_NR_DRAM_BANKS=1
CONFIG_VERSION_VARIABLE=y
# CONFIG_DISPLAY_BOARDINFO is not set
CONFIG_ARCH_MISC_INIT=y
# CONFIG_SPL_FRAMEWORK is not set
CONFIG_HUSH_PARSER=y
CONFIG_CMD_BOOTZ=y
# CONFIG_CMD_FLASH is not set
CONFIG_CMD_GPIO=y
CONFIG_CMD_MMC=y
CONFIG_CMD_CACHE=y
CONFIG_CMD_EXT4=y
CONFIG_CMD_EXT4_WRITE=y
CONFIG_CMD_FAT=y
CONFIG_CMD_FS_GENERIC=y
CONFIG_ENV_IS_IN_MMC=y
# CONFIG_NET is not set
CONFIG_MMC_MXS=y
CONFIG_CONS_INDEX=0
CONFIG_VIDEO=y
CONFIG_OF_LIBFDT=y
```
